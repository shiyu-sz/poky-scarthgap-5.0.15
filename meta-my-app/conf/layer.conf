## meta-my-app/conf/layer.conf
```bitbake
# We have a conf and classes directory, add to BBPATH
BBPATH .= ":${LAYERDIR}"

# We have recipes-* directories, add to BBFILES
BBFILES += "${LAYERDIR}/recipes-*/*/*.bb \
            ${LAYERDIR}/recipes-*/*/*.bbappend"

BBFILE_COLLECTIONS += "meta-my-app"
BBFILE_PATTERN_meta-my-app = "^${LAYERDIR}/"
BBFILE_PRIORITY_meta-my-app = "6"

LAYERDEPENDS_meta-my-app = "core"
LAYERSERIES_COMPAT_meta-my-app = "scarthgap"

# 强制开启 OpenGL 特性
DISTRO_FEATURES:append = " opengl"

# 控制BitBake同时执行的任务数（如同时编译多个不同的软件包）
BB_NUMBER_THREADS = "8"

# 控制每个编译任务（do_compile）内部 make 工具使用的线程数
PARALLEL_MAKE = "-j 8"
```
